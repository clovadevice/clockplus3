## kernel/msm-4.14/drivers/misc/markt/Kconfig
```kconfig
config MARKT_FACTORY_INFO
	bool  "Select use markt factory info"
	default n


config MARKT_IR_GPIO
	bool "select use ir-gpio driver"
	default n
```
